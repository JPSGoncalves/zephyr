## samples/subsys/ipc/openamp_rsc_table/boards/milkv_duos_sg2000_c906_1.conf
```kconfig
# SPDX-FileCopyrightText: Copyright The Zephyr Project Contributors
# SPDX-License-Identifier: Apache-2.0

CONFIG_LOG=y
CONFIG_RAM_CONSOLE=y
CONFIG_UART_CONSOLE=n
CONFIG_LOG_MODE_MINIMAL=y
CONFIG_OPENAMP_COPY_RSC_TABLE=y
CONFIG_SHELL_BACKEND_SERIAL=n
```

## soc/sophgo/cv181x/Kconfig
```kconfig
# Copyright (c) 2024 Chen Xingyu <hi@xingrz.me>
# SPDX-License-Identifier: Apache-2.0

config SOC_SERIES_CV181X
	select RISCV
	select RISCV_PRIVILEGED
	select RISCV_SOC_HAS_GP_RELATIVE_ADDRESSING
	select INCLUDE_RESET_VECTOR
```
